## meta-Tagore/conf/layer.conf
```bitbake
# We have a conf and classes directory, add to BBPATH
BBPATH .= ":${LAYERDIR}"

# We have recipes-* directories, add to BBFILES
BBFILES += "${LAYERDIR}/recipes-*/*/*.bb \
            ${LAYERDIR}/recipes-*/*/*.bbappend"

BBFILE_COLLECTIONS += "meta-filename"
BBFILE_PATTERN_meta-filename = "^${LAYERDIR}/"
BBFILE_PRIORITY_meta-filename = "6"

LAYERDEPENDS_meta-filename = "core"
LAYERSERIES_COMPAT_meta-filename = "kirkstone"
```

## meta-cpp/conf/layer.conf
```bitbake
# We have a conf and classes directory, add to BBPATH
BBPATH .= ":${LAYERDIR}"

# We have recipes-* directories, add to BBFILES
BBFILES += "${LAYERDIR}/recipes-*/*/*.bb \
            ${LAYERDIR}/recipes-*/*/*.bbappend"

# Unique layer name
BBFILE_COLLECTIONS += "meta-cpp"
BBFILE_PATTERN_meta-cpp = "^${LAYERDIR}/"
BBFILE_PRIORITY_meta-cpp = "6"

# Layer dependencies (optional)
LAYERDEPENDS_meta-cpp = "core"
LAYERSERIES_COMPAT_meta-cpp = "kirkstone"
```

## meta-libmodbus/conf/layer.conf
```bitbake
# We have a conf and classes directory, add to BBPATH
BBPATH .= ":${LAYERDIR}"

# We have recipes-* directories, add to BBFILES
BBFILES += "${LAYERDIR}/recipes-*/*/*.bb \
            ${LAYERDIR}/recipes-*/*/*.bbappend"

BBFILE_COLLECTIONS += "meta-libmodbus"
BBFILE_PATTERN_meta-libmodbus = "^${LAYERDIR}/"
BBFILE_PRIORITY_meta-libmodbus = "6"

LAYERDEPENDS_meta-libmodbus = "core"
LAYERSERIES_COMPAT_meta-libmodbus = "kirkstone"
```
